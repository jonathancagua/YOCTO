## meta-testjc/conf/layer.conf
```bitbake
# We have a conf and classes directory, add to BBPATH
BBPATH .= ":${LAYERDIR}"

# We have recipes-* directories, add to BBFILES
BBFILES += "${LAYERDIR}/recipes-*/*/*.bb \
            ${LAYERDIR}/recipes-*/*/*.bbappend"

BBFILE_COLLECTIONS += "meta-testjc"
BBFILE_PATTERN_meta-testjc = "^${LAYERDIR}/"
BBFILE_PRIORITY_meta-testjc = "6"

LAYERDEPENDS_meta-testjc = "core"
LAYERSERIES_COMPAT_meta-testjc = "kirkstone"
```
